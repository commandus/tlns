## main/Kconfig.projbuild
```kconfig
menu "LoRaWAN gateway storage"

config ESP_SOCK_TARGET_HOST
    string "Target host address"
    default "84.237.104.128"
    help
        IP v.4 address

    config ESP_UDP_SOCK_PORT
        int "Target host address"
        default "4242"
        help
            IP port number
        
    config ESP_WIFI_SSID
        string "WiFi SSID"
        default "ikfia-guest"
        help
            SSID (network name) for the Wi-Fi station to connect to.

    config ESP_WIFI_PASSWORD
        string "WiFi Password"
        default "f95nder9"
        help
            WiFi password (WPA or WPA2) for the Wi-Fi station to use.

    choice ESP_WIFI_SAE_MODE
        prompt "WPA3 SAE mode selection"
        default ESP_WPA3_SAE_PWE_BOTH
        help
            Select mode for SAE as Hunt and Peck, H2E or both.
        config ESP_WPA3_SAE_PWE_HUNT_AND_PECK
            bool "HUNT AND PECK"
        config ESP_WPA3_SAE_PWE_HASH_TO_ELEMENT
            bool "H2E"
        config ESP_WPA3_SAE_PWE_BOTH
            bool "BOTH"
    endchoice

    config ESP_WIFI_PW_ID
        string "PASSWORD IDENTIFIER"
        depends on  ESP_WPA3_SAE_PWE_HASH_TO_ELEMENT|| ESP_WPA3_SAE_PWE_BOTH
        default ""
        help
            password identifier for SAE H2E

    config ESP_MAXIMUM_RETRY
        int "Maximum retry"
        default 5
        help
            Set the Maximum retry to avoid station reconnecting to the AP unlimited when the AP is really inexistent.

    choice ESP_WIFI_SCAN_AUTH_MODE_THRESHOLD
        prompt "WiFi Scan auth mode threshold"
        default ESP_WIFI_AUTH_WPA2_PSK
        help
            The weakest authmode to accept in the scan mode.
            This value defaults to ESP_WIFI_AUTH_WPA2_PSK incase password is present and ESP_WIFI_AUTH_OPEN is used.
            Please select ESP_WIFI_AUTH_WEP/ESP_WIFI_AUTH_WPA_PSK incase AP is operating in WEP/WPA mode.

        config ESP_WIFI_AUTH_OPEN
            bool "OPEN"
        config ESP_WIFI_AUTH_WEP
            bool "WEP"
        config ESP_WIFI_AUTH_WPA_PSK
            bool "WPA PSK"
        config ESP_WIFI_AUTH_WPA2_PSK
            bool "WPA2 PSK"
        config ESP_WIFI_AUTH_WPA_WPA2_PSK
            bool "WPA/WPA2 PSK"
        config ESP_WIFI_AUTH_WPA3_PSK
            bool "WPA3 PSK"
        config ESP_WIFI_AUTH_WPA2_WPA3_PSK
            bool "WPA2/WPA3 PSK"
        config ESP_WIFI_AUTH_WAPI_PSK
            bool "WAPI PSK"
    endchoice

    choice ESP_KEY_GEN_CHOICE
        prompt "Enable key-gen"
        default ESP_KEY_GEN
        help
            Key generator use master key in LoRaWAN keys calculation for all devices.
        config ESP_KEY_GEN
            bool "Enabled"
        config ESP_NO_KEY_GEN
            bool "Disabled"
    endchoice

    config ESP_PASSPHRASE
        string "Passphrase set master key value. Passphrase  must 10-20 characters long"
        default "masterkey"
        help
            Passphrase set master key

    config ESP_NWK_TYPE_ID
        int "Network type 0..7"
        default 0
        help
            Set 0 or 1 for unregistered networks

    config ESP_NWK_ID
        int "Network identifier 0..N"
        default 0
        help
            Maximum network number depends on network type

    config ESP_CODE
        int "Code, Account #"
        default 42
        help
            Account number in request, default 42(0x2a)

    config ESP_ACCESS_CODE_HI
        int "Access code hi bytes"
        default 42
        help
            Magic number in request, default 42(0x2a)
    config ESP_ACCESS_CODE_LO
        int "Access code lo bytes"
        default 42
        help
            Magic number in request, default 42(0x2a)

    choice ESP_DEBUG
        prompt "Enable debug output"
        default ESP_ENABLE_DEBUG
        help
            Enable detailed log output
        config ESP_ENABLE_DEBUG
            bool "Enabled"
        config ESP_DISABLE_DEBUG
            bool "Disabled"
    endchoice
        
endmenu
```
